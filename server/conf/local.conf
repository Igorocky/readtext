## server/conf/local.conf
```bitbake
db {
  host = localhost
  port = 9092
  name = "playexample2"
  user = "playexample2-user"
  password = "playexample2-pass"
}

topicsImgStorageDir= "D:/temp/uploaded"
```
